## config/west.yml
```yaml
manifest:
  remotes:
    - name: javier-varez
      url-base: https://github.com/javier-varez
  projects:
    - name: zmk
      remote: javier-varez
      revision: main
      import: app/west.yml
  self:
    path: config
```
